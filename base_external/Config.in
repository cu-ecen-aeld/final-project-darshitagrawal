## base_external/Config.in
```kconfig
source "$BR2_EXTERNAL_assignment_base_PATH/package/aesd-assignments/Config.in"
source "$BR2_EXTERNAL_assignment_base_PATH/package/pigpio-gpio/Config.in"
source "$BR2_EXTERNAL_assignment_base_PATH/package/mlx90614/Config.in"
source "$BR2_EXTERNAL_assignment_base_PATH/package/humidity/Config.in"
source "$BR2_EXTERNAL_assignment_base_PATH/package/socket/Config.in"
```

## base_external/package/humidity/Config.in
```kconfig
config BR2_PACKAGE_HUMIDITY
	bool "humidity"
	help
	  Includes the gpio user-space driver for humidity sensor.
	  
```

## base_external/package/mlx90614/Config.in
```kconfig
config BR2_PACKAGE_MLX90614
	bool "mlx90614"
	help
	  Includes the i2c user-space driver for MLX90614 temperature sensor.
	  
```

## base_external/package/pigpio-gpio/Config.in
```kconfig
config BR2_PACKAGE_PIGPIO_GPIO
	bool "pigpio-gpio"
	help
	  Includes the shell script for gpio based on pigpio.
	  
```

## base_external/package/sensors/Config.in
```kconfig
config BR2_PACKAGE_SENSORS
	bool "sensors"
	help
	  Includes the i2c user-space driver for MLX90614 temperature sensor and HTU21D humidity sensor.
	  
```
